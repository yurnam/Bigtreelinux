## esp32s3-linux/br2-external/configs/esp32s3_pandatouch_defconfig
```kconfig
# Buildroot defconfig for BigTreeTech PandaTouch (ESP32-S3, 8 MB flash, 8 MB PSRAM)
#
# Based on the upstream esp32s3_devkit_c1_8m configuration from
# https://github.com/jcmvbkbc/buildroot (branch xtensa-2024.08-fdpic)
# with the following additions:
#   - Device-tree source for PandaTouch (esp32s3-pandatouch.dts)
#   - Kernel config fragment enabling framebuffer, GT911 touch, USB storage
#   - Rootfs overlay with display init scripts
#   - fbset, tslib, evtest userspace packages

# ── Architecture ──────────────────────────────────────────────────────────
BR2_xtensa=y
# Use xtensa-dynconfig (gcc-13 / binutils-2.40+).
# The rebuild script sets XTENSA_GNU_CONFIG="<path>/xtensa-dynconfig/esp32s3.so"
# before calling make; Buildroot passes it through to the toolchain.
BR2_XTENSA_DYNCONFIG=y
BR2_XTENSA_LITTLE_ENDIAN=y
BR2_XTENSA_USE_MMU=y
# Try to set BR2_USE_MMU=y. This may be silently dropped by olddefconfig in
# the jcmvbkbc fork (broken select chain). The definitive fix is three-part:
# 1. br2-external/external.mk overrides BUSYBOX_SET_MMU (disables CONFIG_NOMMU)
# 2. busybox-mmu.config adds CONFIG_EXTRA_CFLAGS="-D__ARCH_USE_MMU__" (forces BB_MMU=1)
# 3. Build scripts pass BR2_USE_MMU=y on the make command line
BR2_USE_MMU=y

# ── Toolchain ─────────────────────────────────────────────────────────────
# The path and prefix are injected by rebuild-esp32s3-pandatouch.sh after
# the defconfig is applied (same technique as the upstream script).
BR2_TOOLCHAIN_EXTERNAL=y
BR2_TOOLCHAIN_EXTERNAL_CUSTOM=y
BR2_TOOLCHAIN_EXTERNAL_PATH=""
BR2_TOOLCHAIN_EXTERNAL_GCC_12=y
# crosstool-NG clones linux v6.6 for kernel headers (branch v6.6):
BR2_TOOLCHAIN_EXTERNAL_HEADERS_6_6=y
BR2_TOOLCHAIN_EXTERNAL_CUSTOM_UCLIBC=y
# uClibc-ng built with --enable-wchar:
BR2_TOOLCHAIN_EXTERNAL_WCHAR=y
BR2_TOOLCHAIN_EXTERNAL_HAS_SSP=y
BR2_TOOLCHAIN_EXTERNAL_CXX=y

# ── Build options ─────────────────────────────────────────────────────────
BR2_OPTIMIZE_S=y

# ── Kernel ────────────────────────────────────────────────────────────────
BR2_LINUX_KERNEL=y
BR2_LINUX_KERNEL_CUSTOM_GIT=y
BR2_LINUX_KERNEL_CUSTOM_REPO_URL="https://github.com/jcmvbkbc/linux-xtensa.git"
BR2_LINUX_KERNEL_CUSTOM_REPO_VERSION="xtensa-fdpic"
BR2_LINUX_KERNEL_DEFCONFIG="esp32s3"
# Extra kernel config fragment enables framebuffer, GT911, USB storage:
BR2_LINUX_KERNEL_CONFIG_FRAGMENT_FILES="$(BR2_EXTERNAL_PANDATOUCH_PATH)/board/pandatouch/linux-extras.config"
# Device-tree
# CUSTOM_DTS_PATH tells Buildroot to copy the DTS into the kernel source tree
# BEFORE the kernel is compiled (a Buildroot post-patch hook).  This avoids
# the race condition where an in-tree reference would fail on a fresh build
# because the kernel source hasn't been extracted yet at defconfig time.
BR2_LINUX_KERNEL_DTS_SUPPORT=y
BR2_LINUX_KERNEL_CUSTOM_DTS_PATH="$(BR2_EXTERNAL_PANDATOUCH_PATH)/board/pandatouch/esp32s3-pandatouch.dts"
BR2_LINUX_KERNEL_INTREE_DTS_NAME="esp32s3-pandatouch"
BR2_LINUX_KERNEL_IMAGE_TARGET_NAME="xipImage"

# ── System ────────────────────────────────────────────────────────────────
BR2_TARGET_GENERIC_HOSTNAME="pandatouch"
BR2_TARGET_GENERIC_ISSUE="BigTreeTech PandaTouch Linux"
# Use the rootfs overlay to inject display/touch init scripts
BR2_ROOTFS_OVERLAY="$(BR2_EXTERNAL_PANDATOUCH_PATH)/board/pandatouch/rootfs-overlay"
BR2_ROOTFS_POST_BUILD_SCRIPT="$(BR2_EXTERNAL_PANDATOUCH_PATH)/board/pandatouch/post-build.sh"
# mkfs-etc.sh runs inside the jffs2 fakeroot and trims the staging tree so
# only /etc content ends up in the jffs2 image (mirroring upstream behaviour).
BR2_ROOTFS_POST_FAKEROOT_SCRIPT="$(BR2_EXTERNAL_PANDATOUCH_PATH)/board/pandatouch/mkfs-etc.sh"
# post-image.sh renames the generic rootfs.jffs2 → etc.jffs2 so the flash
# script can identify and write it to the correct SPI-NOR partition.
BR2_ROOTFS_POST_IMAGE_SCRIPT="$(BR2_EXTERNAL_PANDATOUCH_PATH)/board/pandatouch/post-image.sh"

# ── Root filesystem ───────────────────────────────────────────────────────
# cramfs (read-only, compressed) fits in the "rootfs" SPI-NOR partition.
BR2_TARGET_ROOTFS_CRAMFS=y
# jffs2 for the writable /etc partition (flashed separately as etc.jffs2).
# FLASH_64 matches the upstream devkit layout (64-byte erase block minimum).
BR2_TARGET_ROOTFS_JFFS2=y
BR2_TARGET_ROOTFS_JFFS2_FLASH_64=y

# ── Packages ──────────────────────────────────────────────────────────────
BR2_PACKAGE_BUSYBOX=y
# Force CONFIG_MMU=y so ash compiles (ESP32-S3 has a hardware MMU).
BR2_PACKAGE_BUSYBOX_CONFIG_FRAGMENT_FILES="$(BR2_EXTERNAL_PANDATOUCH_PATH)/board/pandatouch/busybox-mmu.config"

# Framebuffer utilities
BR2_PACKAGE_FBSET=y

# Touchscreen userspace library (calibration, event normalisation)
BR2_PACKAGE_TSLIB=y
BR2_PACKAGE_TSLIB_TESTS=y

# Input event monitor (useful for debugging touch / keyboard)
BR2_PACKAGE_EVTEST=y

# devmem2 – direct MMIO access (useful for GPIO / LCD register debugging)
BR2_PACKAGE_DEVMEM2=y

# mtd-utils – for reading/writing flash partitions from Linux
BR2_PACKAGE_MTD=y
BR2_PACKAGE_MTD_MKFS_JFFS2=y

# USB utilities (lsusb, usb_modeswitch – helpful once USB host is active)
BR2_PACKAGE_USBUTILS=y

# iproute2 – ip link, ip addr
BR2_PACKAGE_IPROUTE2=y

# wpa_supplicant – WiFi (via esp-hosted kernel SPI interface)
BR2_PACKAGE_WPA_SUPPLICANT=y
BR2_PACKAGE_WPA_SUPPLICANT_NL80211=y
```

## esp32s3-linux/br2-external/configs/esp32s3_pandatouch_fb_defconfig
```kconfig
# Buildroot defconfig for BigTreeTech PandaTouch – minimal + framebuffer
#
# USE THIS CONFIG with build-minimal.sh for a fast bring-up image that
# includes the LCD framebuffer but skips the heavy networking packages.
#
# Compared to esp32s3_pandatouch_defconfig this removes:
#   - wpa_supplicant (WiFi, largest package)
#   - tslib / evtest (touch userspace)
#   - iproute2 (networking tools)
#   - mtd-utils (flash tools)
#   - usbutils (lsusb)
#   - devmem2 (MMIO debug)
#
# You still get:
#   - Working framebuffer (/dev/fb0) via simple-framebuffer DT node
#   - Backlight control, fbcon (text on LCD)
#   - BusyBox init + shell
#   - fbset to inspect/set display modes
#   - Serial console (UART0, ttyS0, 115200 baud)
#   - Writable /etc (jffs2)
#
# First build: ~60 min (same toolchain cost as full build).
# Subsequent builds: ~5–10 min when run via build-minimal.sh
# (incremental by default – toolchain and esp-hosted are not rebuilt).

# ── Architecture ──────────────────────────────────────────────────────────
BR2_xtensa=y
BR2_XTENSA_DYNCONFIG=y
BR2_XTENSA_LITTLE_ENDIAN=y
BR2_XTENSA_USE_MMU=y
# Explicitly set BR2_USE_MMU so busybox.mk's BUSYBOX_CONFIG_FIXUPS enables
# CONFIG_MMU instead of disabling it.  In the jcmvbkbc xtensa-fdpic fork the
# BR2_XTENSA_USE_MMU → select BR2_USE_MMU chain is broken.
BR2_USE_MMU=y

# ── Toolchain ─────────────────────────────────────────────────────────────
BR2_TOOLCHAIN_EXTERNAL=y
BR2_TOOLCHAIN_EXTERNAL_CUSTOM=y
BR2_TOOLCHAIN_EXTERNAL_PATH=""
BR2_TOOLCHAIN_EXTERNAL_GCC_12=y
BR2_TOOLCHAIN_EXTERNAL_HEADERS_6_6=y
BR2_TOOLCHAIN_EXTERNAL_CUSTOM_UCLIBC=y
BR2_TOOLCHAIN_EXTERNAL_WCHAR=y
BR2_TOOLCHAIN_EXTERNAL_HAS_SSP=y
BR2_TOOLCHAIN_EXTERNAL_CXX=y

# ── Build options ─────────────────────────────────────────────────────────
BR2_OPTIMIZE_S=y

# ── Kernel ────────────────────────────────────────────────────────────────
BR2_LINUX_KERNEL=y
BR2_LINUX_KERNEL_CUSTOM_GIT=y
BR2_LINUX_KERNEL_CUSTOM_REPO_URL="https://github.com/jcmvbkbc/linux-xtensa.git"
BR2_LINUX_KERNEL_CUSTOM_REPO_VERSION="xtensa-fdpic"
BR2_LINUX_KERNEL_DEFCONFIG="esp32s3"
# Config fragment: framebuffer, GT911 touch driver, USB host
BR2_LINUX_KERNEL_CONFIG_FRAGMENT_FILES="$(BR2_EXTERNAL_PANDATOUCH_PATH)/board/pandatouch/linux-extras.config"
# Device-tree: provides the simple-framebuffer node for /dev/fb0
BR2_LINUX_KERNEL_DTS_SUPPORT=y
BR2_LINUX_KERNEL_CUSTOM_DTS_PATH="$(BR2_EXTERNAL_PANDATOUCH_PATH)/board/pandatouch/esp32s3-pandatouch.dts"
BR2_LINUX_KERNEL_INTREE_DTS_NAME="esp32s3-pandatouch"
BR2_LINUX_KERNEL_IMAGE_TARGET_NAME="xipImage"

# ── System ────────────────────────────────────────────────────────────────
BR2_TARGET_GENERIC_HOSTNAME="pandatouch"
BR2_TARGET_GENERIC_ISSUE="BigTreeTech PandaTouch Linux (minimal+fb)"
BR2_ROOTFS_OVERLAY="$(BR2_EXTERNAL_PANDATOUCH_PATH)/board/pandatouch/rootfs-overlay"
BR2_ROOTFS_POST_BUILD_SCRIPT="$(BR2_EXTERNAL_PANDATOUCH_PATH)/board/pandatouch/post-build.sh"
BR2_ROOTFS_POST_FAKEROOT_SCRIPT="$(BR2_EXTERNAL_PANDATOUCH_PATH)/board/pandatouch/mkfs-etc.sh"
BR2_ROOTFS_POST_IMAGE_SCRIPT="$(BR2_EXTERNAL_PANDATOUCH_PATH)/board/pandatouch/post-image.sh"

# ── Root filesystem ───────────────────────────────────────────────────────
BR2_TARGET_ROOTFS_CRAMFS=y
BR2_TARGET_ROOTFS_JFFS2=y
BR2_TARGET_ROOTFS_JFFS2_FLASH_64=y

# ── Packages ──────────────────────────────────────────────────────────────
BR2_PACKAGE_BUSYBOX=y
# Force CONFIG_MMU=y so ash compiles (ESP32-S3 has a hardware MMU).
BR2_PACKAGE_BUSYBOX_CONFIG_FRAGMENT_FILES="$(BR2_EXTERNAL_PANDATOUCH_PATH)/board/pandatouch/busybox-mmu.config"

# fbset: inspect and set framebuffer display modes
BR2_PACKAGE_FBSET=y
```

## esp32s3-linux/br2-external/configs/esp32s3_pandatouch_minimal_defconfig
```kconfig
# Buildroot minimal defconfig for BigTreeTech PandaTouch
#
# USE THIS CONFIG to get Linux booting as quickly as possible.
#
# Compared to esp32s3_pandatouch_defconfig this strips:
#   - Kernel extras (framebuffer, GT911 touch, USB host drivers)
#   - Device-tree source (framebuffer DT node not needed for serial boot)
#   - All packages except BusyBox (no wpa_supplicant, tslib, mtd-utils, etc.)
#
# You still get:
#   - A working serial console (UART0, ttyS0, 115200 baud)
#   - BusyBox init + sh
#   - Writable /etc (jffs2) for persistent config changes
#
# For the full-featured image (WiFi, framebuffer, touch, USB, tools)
# use esp32s3_pandatouch_defconfig instead.
#
# Build with:
#   ./esp32-linux-build/rebuild-esp32s3-pandatouch-minimal.sh

# ── Architecture ──────────────────────────────────────────────────────────
BR2_xtensa=y
BR2_XTENSA_DYNCONFIG=y
BR2_XTENSA_LITTLE_ENDIAN=y
BR2_XTENSA_USE_MMU=y
# Try to set BR2_USE_MMU=y. This may be silently dropped by olddefconfig in
# the jcmvbkbc fork (broken select chain). The definitive fix is three-part:
# 1. br2-external/external.mk overrides BUSYBOX_SET_MMU (disables CONFIG_NOMMU)
# 2. busybox-mmu.config adds CONFIG_EXTRA_CFLAGS="-D__ARCH_USE_MMU__" (forces BB_MMU=1)
# 3. Build scripts pass BR2_USE_MMU=y on the make command line
BR2_USE_MMU=y

# ── Toolchain ─────────────────────────────────────────────────────────────
BR2_TOOLCHAIN_EXTERNAL=y
BR2_TOOLCHAIN_EXTERNAL_CUSTOM=y
BR2_TOOLCHAIN_EXTERNAL_PATH=""
BR2_TOOLCHAIN_EXTERNAL_GCC_12=y
BR2_TOOLCHAIN_EXTERNAL_HEADERS_6_6=y
BR2_TOOLCHAIN_EXTERNAL_CUSTOM_UCLIBC=y
BR2_TOOLCHAIN_EXTERNAL_WCHAR=y
BR2_TOOLCHAIN_EXTERNAL_HAS_SSP=y
BR2_TOOLCHAIN_EXTERNAL_CXX=y

# ── Build options ─────────────────────────────────────────────────────────
BR2_OPTIMIZE_S=y

# ── Kernel – base esp32s3 defconfig only ──────────────────────────────────
# No framebuffer, no touch, no USB host extras.
# The base esp32s3_defconfig already enables serial UART, SPI-NOR, cramfs
# and jffs2 – everything needed to boot to a BusyBox shell.
BR2_LINUX_KERNEL=y
BR2_LINUX_KERNEL_CUSTOM_GIT=y
BR2_LINUX_KERNEL_CUSTOM_REPO_URL="https://github.com/jcmvbkbc/linux-xtensa.git"
BR2_LINUX_KERNEL_CUSTOM_REPO_VERSION="xtensa-fdpic"
BR2_LINUX_KERNEL_DEFCONFIG="esp32s3"
BR2_LINUX_KERNEL_IMAGE_TARGET_NAME="xipImage"

# ── System ────────────────────────────────────────────────────────────────
BR2_TARGET_GENERIC_HOSTNAME="pandatouch"
BR2_TARGET_GENERIC_ISSUE="BigTreeTech PandaTouch Linux (minimal)"
# Reuse the same rootfs overlay and post-scripts as the full build.
# /etc/inittab and /etc/cmdline (serial console) are provided by the overlay.
# The display/touch init scripts (S10display, S20touchscreen) are harmless
# on a minimal image – they exit gracefully when /dev/fb0 is absent.
BR2_ROOTFS_OVERLAY="$(BR2_EXTERNAL_PANDATOUCH_PATH)/board/pandatouch/rootfs-overlay"
BR2_ROOTFS_POST_BUILD_SCRIPT="$(BR2_EXTERNAL_PANDATOUCH_PATH)/board/pandatouch/post-build.sh"
BR2_ROOTFS_POST_FAKEROOT_SCRIPT="$(BR2_EXTERNAL_PANDATOUCH_PATH)/board/pandatouch/mkfs-etc.sh"
BR2_ROOTFS_POST_IMAGE_SCRIPT="$(BR2_EXTERNAL_PANDATOUCH_PATH)/board/pandatouch/post-image.sh"

# ── Root filesystem ───────────────────────────────────────────────────────
BR2_TARGET_ROOTFS_CRAMFS=y
BR2_TARGET_ROOTFS_JFFS2=y
BR2_TARGET_ROOTFS_JFFS2_FLASH_64=y

# ── Packages – BusyBox only ───────────────────────────────────────────────
BR2_PACKAGE_BUSYBOX=y
# Force CONFIG_MMU=y so ash compiles (ESP32-S3 has a hardware MMU).
BR2_PACKAGE_BUSYBOX_CONFIG_FRAGMENT_FILES="$(BR2_EXTERNAL_PANDATOUCH_PATH)/board/pandatouch/busybox-mmu.config"
```

## esp32s3-linux/lcd-init/sdkconfig.defaults
```kconfig
# sdkconfig.defaults – BigTreeTech PandaTouch lcd-init application
#
# Applied via:  idf.py set-target esp32s3 && idf.py build
#
# Target: ESP32-S3, 8 MB QIO Flash, 8 MB Octal PSRAM (OPI mode)

# ── Target chip ───────────────────────────────────────────────────────────
CONFIG_IDF_TARGET="esp32s3"

# ── Flash ─────────────────────────────────────────────────────────────────
CONFIG_ESPTOOLPY_FLASHMODE_QIO=y
CONFIG_ESPTOOLPY_FLASHFREQ_80M=y
CONFIG_ESPTOOLPY_FLASHSIZE_8MB=y

# ── PSRAM ─────────────────────────────────────────────────────────────────
# Enable Octal SPI PSRAM (8 MB) at 80 MHz
CONFIG_SPIRAM=y
CONFIG_SPIRAM_MODE_OCT=y
CONFIG_SPIRAM_SPEED_80M=y
CONFIG_SPIRAM_FETCH_INSTRUCTIONS=y
CONFIG_SPIRAM_RODATA=y
# Allow malloc() to fall back to PSRAM when internal heap is full
CONFIG_SPIRAM_USE_MALLOC=y

# ── CPU speed ─────────────────────────────────────────────────────────────
CONFIG_ESP_DEFAULT_CPU_FREQ_MHZ_240=y

# ── Bootloader log ────────────────────────────────────────────────────────
CONFIG_BOOTLOADER_LOG_LEVEL_WARN=y

# ── Application log ───────────────────────────────────────────────────────
CONFIG_LOG_DEFAULT_LEVEL_INFO=y

# ── UART console ──────────────────────────────────────────────────────────
CONFIG_ESP_CONSOLE_UART_DEFAULT=y
CONFIG_ESP_CONSOLE_UART_NUM=0
CONFIG_ESP_CONSOLE_UART_BAUDRATE=115200

# ── Partition table ───────────────────────────────────────────────────────
# Use the custom partitions.csv in this directory
CONFIG_PARTITION_TABLE_CUSTOM=y
CONFIG_PARTITION_TABLE_CUSTOM_FILENAME="partitions.csv"

# ── FreeRTOS ──────────────────────────────────────────────────────────────
# Minimal tick rate – lcd-init exits quickly so tick rate doesn't matter much
CONFIG_FREERTOS_HZ=100
```
